## config/west.yml
```yaml
manifest:
  remotes:
    - name: zmkfirmware
      url-base: https://github.com/zmkfirmware
    - name: zmk
      url-base: https://github.com/krikun98
  projects:
    - name: zmk
      remote: zmk
      revision: mouse-pr
      import: app/west.yml
  self:
    path: config
```
